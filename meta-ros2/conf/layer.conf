## meta-ros2/conf/layer.conf
```bitbake
# We have a conf and classes directory, append to BBPATH
BBPATH .= ":${LAYERDIR}"

# We have a recipes directory, add to BBFILES
BBFILES += "${LAYERDIR}/recipes-*/*/*.bb ${LAYERDIR}/recipes-*/*/*.bbappend"

BBFILE_COLLECTIONS += "meta-ros2"
BBFILE_PATTERN_meta-ros2 = "^${LAYERDIR}"
BBFILE_PRIORITY_meta-ros2 = "5"
LAYERVERSION_meta-ros2 = "1"
LAYERSERIES_COMPAT_meta-ros2 = "warrior"
```
